## arch/arm/mach-s5pv210/Kconfig
```kconfig
# arch/arm/mach-s5pv210/Kconfig
#
# Copyright 2008 Openmoko, Inc.
# Copyright 2008 Simtec Electronics
#
# Licensed under GPLv2

# Configuration options for the S5PV210 CPU

config CPU_S5PV210
	bool
	select CPU_S5PV210_INIT
	select CPU_S5PV210_CLOCK
	select S5PV210_PM if PM
	help
		Enable S5PV210 CPU support

config S5PV2XX_SETUP_SDHCI
	bool
	help
		Internal helper functions for S5PC1XX based SDHCI systems

config MACH_SMDKV210
	bool "SMDKV210"
	select CPU_S5PV210
	select S3C_DMA_PL330
	select S3C_DEV_I2C1
	select S3C_DEV_HSMMC
	select S3C_DEV_I2C2
	select S3C_DEV_HSMMC1 if !SMDKV210_SD_CH0_8BIT
	select S3C_DEV_HSMMC2
	select S3C_DEV_HSMMC3 if !SMDKV210_SD_CH2_8BIT       
	select S5PV2XX_SETUP_SDHCI
	select S3C64XX_SETUP_I2C1
	help
	  Machine support for the Samsung SMDKV210

choice
	prompt "Setup CPU Type for S5PV210"
	depends on PLAT_S5PV2XX
	default S5PV210_H_TYPE

config S5PV210_H_TYPE
	bool "Select H-Type"
	select ARCH_DISCONTIGMEM_ENABLE
	depends on PLAT_S5PV2XX
	help
		Select H-Type of S5PV210

config S5PV210_AC_TYPE
	bool "select AC-Type"
	select ARCH_DISCONTIGMEM_ENABLE
	depends on PLAT_S5PV2XX
	help
		Select AC-Type of S5PV210

config S5PV210_SINGLE_TYPE
	bool "select SINGLE-Type"
	select ARCH_FLATMEM_HAS_HOLES
	depends on PLAT_S5PV2XX
	help
		Select SINGLE-Type of S5PV210

endchoice

	comment "MMC/SD slot setup"
	depends on MACH_SMDKV210	

config SMDKV210_SD_CH0_8BIT
	bool "Use 8-bit bus with channel 0"
	depends on MACH_SMDKV210
	default n
	help
		IF channel 0 uses 8-bit bus, channel 1 shoule be disabled.
       
config SMDKV210_SD_CH2_8BIT
	bool "Use 8-bit bus with channel 2"
	depends on MACH_SMDKV210
	default n	
	help
		IF channel 2 uses 8-bit bus, channel 3 shoule be disabled.

config DM9000_16BIT
	bool "Use 16-bit bus for DM9000 ethernet controller"
	depends on MACH_SMDKV210
	default n
	help
		Some SMDKV210 board have 16bit data bus for DM9000 ethernet controller..

config S5PV210_PM
	bool
	help
		Power Management code common to S5PV210

choice
	prompt "CPU revision"
	depends on CPU_S5PV210
	default CPU_S5PV210_EVT1

config CPU_S5PV210_EVT0
	bool "EVT0"
	help
		Only for EVT0 version

config CPU_S5PV210_EVT1
	bool "EVT1"
	help
		Only for EVT1 version
endchoice

choice
	prompt "Select RESET type on S5PV210"
	depends on CPU_S5PV210
	default USE_WDT_RESET

config USE_WDT_RESET
	bool "Using watchdog"
	help
		Use WDT to support reset

config USE_SW_RESET
	bool "Using SWRESET"
	help
		Use SWRESET to support reset

endchoice
```

## arch/arm/plat-s5pv2xx/Kconfig
```kconfig
# arch/arm/plat-s5pv2xx/Kconfig
#
# Copyright 2008 Openmoko, Inc.
# Copyright 2008 Simtec Electronics
#	Ben Dooks <ben@simtec.co.uk>
#
# Licensed under GPLv2

config PLAT_S5PV2XX
	bool
	depends on ARCH_S5PV2XX
	select CPU_V7
	select PLAT_S3C
	select ARM_VIC
	default y
	select NO_IOPORT
	select ARCH_REQUIRE_GPIOLIB
	select S3C_GPIO_TRACK
	select S3C_GPIO_PULL_UPDOWN
	select S3C_GPIO_CFG_S5PC1XX
	select DMABOUNCE
	help
	  Base platform code for any Samsung S5PV2XX device


if PLAT_S5PV2XX
# Configuration options shared by all S5PV2XX implementations

config CPU_S5PV210_INIT
	bool
	depends on CPU_S5PV210
	default y	
	help
	  Common initialisation code for the S5PC100 that is shared
	  by other CPUs in the series, such as the S5PV210.

config CPU_S5PV210_CLOCK
	bool
	depends on CPU_S5PV210
	default y	
	help
	  Common clock support code for the S5PC100 that is shared
	  by other CPUs in the series, such as the S5PV210.

# platform specific device setup

config S5PV2XX_SETUP_I2C0
	bool
	default y
	help
	  Common setup code for i2c bus 0.

	  Note, currently since i2c0 is always compiled, this setup helper
	  is always compiled with it.

config S5PV2XX_SETUP_I2C1
	bool
	default y
	help
	  Common setup code for i2c bus 1.

config S5PV2XX_SETUP_I2C2
	bool
	default y
	help
	  Common setup code for i2c bus 2.

config S5PV2XX_ADC
        bool "S5PV2XX_ ADC Driver"
        depends on PLAT_S5PV2XX
        help
          ADC (A/D Conversion) driver for Samsung S5PV2XX.

# MIPI-CSIS part
config S5PV2XX_DEV_CSIS
	bool
	default y
	help
	  Compile in platform device definitions for MIPI-CSIS

config S5PV2XX_SETUP_CSIS
	bool
	default y
	help
	  Common setup code for MIPI-CSIS

# IPC part
config S5PV2XX_DEV_IPC
	bool
	default y
	help
	  Compile in platform device definitions for IPC

# FIMC part
config S5PV2XX_DEV_FIMC0
	bool
	default y
	help
	  Compile in platform device definitions for FIMC controller 0

config S5PV2XX_DEV_FIMC1
	bool
	default y
	help
	  Compile in platform device definitions for FIMC controller 1

config S5PV2XX_DEV_FIMC2
	bool
	default y
	help
	  Compile in platform device definitions for FIMC controller 2

config S5PV2XX_SETUP_FIMC0
	bool
	default y
	help
	  Common setup code for FIMC controller 0.

config S5PV2XX_SETUP_FIMC1
	bool
	default y
	help
	  Common setup code for FIMC controller 1.

config S5PV2XX_SETUP_FIMC2
	bool
	default y
	help
	  Common setup code for FIMC controller 2.

# MFC part
config S5PV2XX_DEV_MFC
	bool
	default y
	help
	  Compile in platform device definitions for MFC

config S5PV2XX_SETUP_MFC
	bool
	default y
	help
	  Common setup code for MFC

# FB part
config S5PV2XX_DEV_FB
	bool
	depends on FB_S3C
	default y
	help
	  Compile in platform device definitions for FIMD controller

config S5PV2XX_SETUP_FB
	bool
	depends on FB_S3C
	default y
	help
	  Common setup code for FIMD controller.

config S5P_HAVE_PWM
        bool "PWM device support"
        select HAVE_PWM
        help
           Support for exporting the PWM timer blocks via the pwm device

config S5P_TICKLESS_IDLE
	bool "Enabling tickless idle and HRT on S5PV210"
	select GENERIC_TIME
	select GENERIC_CLOCKEVENTS 
	select NO_HZ 
	default n
	help
	  Support tickless idle and HRT through pwm timer
endif
```

## drivers/media/video/samsung/cmm/Kconfig
```kconfig
#
# Configuration for CMM
#

config VIDEO_CMM
	bool "Samsung CMM Driver"
	depends on VIDEO_SAMSUNG && CPU_S5PV210
	default n
	---help---
	  This is a CMM driver for Samsung S5PV210.
```

## drivers/media/video/samsung/tv20/Kconfig
```kconfig
#
# Configuration for Post Porcessor
#

config VIDEO_TV20
	bool "Samsung TV Driver"
	depends on VIDEO_SAMSUNG
	default n
	---help---
	  This is a TV driver for Samsung AP

config HDMI_CEC
	bool "HDMI CEC driver support."
	depends on VIDEO_TV20 && CPU_S5PV210
	default y
	---help---
	  This is a HDMI CEC driver for Samsung AP
	  Check dev node (major 10, minor 242)

config HDMI_HPD
	bool "HDMI HPD driver support."
	depends on VIDEO_TV20 && CPU_S5PV210
	default y
	---help---
	  This is a HDMI HPD driver for Samsung AP
	  Check dev node (major 10, minor 243)
```
